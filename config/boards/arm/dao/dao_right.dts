/*
 * Copyright (c) 2021 Rafael Yumagulov
 *
 * SPDX-License-Identifier: MIT
 */

#include "dao.dtsi"

&default_transform {
	col-offset = <6>;
};

&extra_keys_transform {
	col-offset = <6>;
};

&kscan0 {
	col-gpios
		= <&gpio0 30 GPIO_ACTIVE_HIGH>
		, <&gpio1 31 GPIO_ACTIVE_HIGH>
		, <&gpio0 29 GPIO_ACTIVE_HIGH>
		, <&gpio0 02 GPIO_ACTIVE_HIGH>
		, <&gpio1 13 GPIO_ACTIVE_HIGH>
		, <&gpio0 03 GPIO_ACTIVE_HIGH>
		;
};
